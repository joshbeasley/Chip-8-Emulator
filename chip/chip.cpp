#include "chip.h"
#include "cpu_helpers.h"

uint8_t builtinsprites[81] = { 0xF0,0x90, 0x90,0x90, 0xF0,	//0 starts at 0x000
		    0x20,0x60, 0x20,0x20, 0x70,	//1 starts at 0x005
		    0xF0,0x10, 0xF0,0x80, 0xF0,	//2 starts at 0x00A
		    0xF0,0x10, 0xF0,0x10, 0xF0,	//3 starts at 0x00F
		    0x90,0x90, 0xF0,0x10, 0x10,	//4 starts at 0x014
		    0xF0,0x80, 0xF0,0x10, 0xF0,	//5 starts at 0x019
		    0xF0,0x80, 0xF0,0x90, 0xF0,	//6 starts at 0x01E
		    0xF0,0x10, 0x20,0x40, 0x40,	//7 starts at 0x023
		    0xF0,0x90, 0xF0,0x90, 0xF0,	//8 starts at 0x028
		    0xF0,0x90, 0xF0,0x10, 0xF0,	//9 starts at 0x02D
		    0xF0,0x90, 0xF0,0x90, 0x90,	//A starts at 0x032
		    0xE0,0x90, 0xE0,0x90, 0xE0,	//B starts at 0x037
		    0xF0,0x80, 0x80,0x80, 0xF0,	//C starts at 0x03C
		    0xE0,0x90, 0x90,0x90, 0xE0,	//D starts at 0x041
		    0xF0,0x80, 0xF0,0x80, 0xF0,	//E starts at 0x046
		    0xF0,0x80, 0xF0,0x80, 0x80,	//F starts at 0x04C
		    '\0'};

void chipInit(chip8 *c8){
	
	c8 -> programCounter = START_LOCATION;			//starting memory
	c8 -> iRegister = 0x0;
	c8 -> delayTimer = 0x0;
	c8 -> soundTimer = 0x0;
	c8 -> stack = stack_init();
	if(c8 -> dataMemory == NULL){
		Serial.println("we here");
	}
	for(int i = 0; i < REG_LOCATIONS; i++){
		(c8 -> dataRegister)[i] = 0x00;
	}
	for(int i = 0; i  < MEM_SIZE; i++){
		(c8 -> dataMemory)[i] = 0x00;
	}
	for(int i =0; i< SCREEN_W; i++){
	 	for(int j = 0; j < SCREEN_H; j++){
	 		(c8 -> chipScreen.binaryDisplay)[i][j] = BLACK;
	 	}
	}
	c8 -> on = 1;


	loadSprites(builtinsprites, c8 -> dataMemory);
}

void chipQuit(chip8 *c8){
	c8 -> on = 0;
	exit(1);
}





